## boards/shields/skylight/Kconfig.defconfig
```kconfig
if SHIELD_SKYLIGHT_LEFT

# Name must be less than 16 characters long!
config ZMK_KEYBOARD_NAME
    default "skylight"

config ZMK_SPLIT_ROLE_CENTRAL
    default y

endif

if SHIELD_SKYLIGHT_LEFT || SHIELD_SKYLIGHT_RIGHT

config ZMK_SPLIT
    default y

endif
```

## boards/shields/skylight/Kconfig.shield
```kconfig
# No whitespace after the comma or in your part name!
config SHIELD_SKYLIGHT_LEFT
    def_bool $(shields_list_contains,skylight_left)

# No whitespace after the comma or in your part name!
config SHIELD_SKYLIGHT_RIGHT
    def_bool $(shields_list_contains,skylight_right)
```
